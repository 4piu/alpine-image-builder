/*
 * Enables the onboard AW859A (Unisoc UWE5622) wifi/BT combo chip --
 * see target/README.md and common/patches/ for this target for
 * the driver itself; this overlay is just the devicetree side.
 *
 * The mmc1 power-sequencing/regulator wiring (vmmc/vqmmc-supply,
 * mmc-pwrseq, bus-width, non-removable) used to live here as a
 * project-local overlay fragment, reverse-engineered by decompiling
 * Orange Pi's own firmware DT. It's since been found to already exist
 * as a real, importable patch upstream --
 * common/patches/0006-dt-wifi-pwrseq-from-armbian.patch (adapted from
 * armbian/build) -- which adds the same nodes, under the same labels
 * (reg_vcc33_wifi, reg_vcc_wifi_io, wifi_pwrseq), directly to the base
 * sun50i-h616-orangepi-zero.dtsi this board's own .dts already
 * #includes. That patch is applied before this overlay, so this file
 * only needs to reference &wifi_pwrseq etc. via the platform node below,
 * not redefine them -- redefining the same node labels here as well
 * would conflict at DT-compile time, not just duplicate work.
 *
 * What's left below has no Armbian equivalent, checked directly against
 * every patch/kernel/, patch/misc/, and armbian/firmware tree that
 * exists for this board (see notes/armbian-kernel-patches-brainstorm.md)
 * -- it's specific to attaching *this* driver to the SDIO bus, not
 * something Armbian's own DT patch (which only wires up mmc1's power
 * sequencing, not the driver-facing platform node) needed to solve.
 *
 * pub-int-gpio (PG15, "wlan hostwake" on the real firmware's DT) is
 * deliberately NOT wired up here, and that's confirmed, not a gap:
 * a first real-hardware boot with it set caused an interrupt storm
 * (sdio_pub_int_init() arms it immediately in marlin_probe(), well
 * before the chip has even been through its power-up/firmware-load
 * sequence -- with nothing yet driving the line to a real level, it
 * free-runs, hundreds of thousands of "sdio cmd52 fail"/irq_cnt
 * lines a second). The driver already treats this GPIO as optional
 * (every use is behind `if (marlin_dev->int_ap > 0)`), so omitting
 * it is a clean, supported way to disable this "public interrupt"/
 * wake-source feature, not a workaround. bt-wake-host-gpio (PG16) is
 * a separate, unrelated line and unaffected.
 */
/dts-v1/;
/plugin/;

#include <dt-bindings/gpio/gpio.h>

/ {
	compatible = "xunlong,orangepi-zero3", "allwinner,sun50i-h618";

	fragment@0 {
		target-path = "/";
		__overlay__ {
			/*
			 * Node name matters here, separately from
			 * "compatible": unisocwcn/sdio/sdiohal_main.c's
			 * sdiohal_parse_dt() looks this node up by literal
			 * name (of_find_node_by_name(NULL, "uwe-bsp")), not
			 * by compatible string -- that's a completely
			 * different, driver-internal lookup from the one the
			 * "unisoc,uwe_bsp" platform driver itself uses to
			 * match this node. Naming it anything else (e.g.
			 * "uwe5622-bsp") makes that lookup silently fail,
			 * leaving irq_type/gpio_num and friends at their
			 * zero-initialized defaults -- request_irq(0, ...)
			 * failing with -EINVAL ("request irq err gpio is 0")
			 * is what that looks like on real hardware; it is
			 * not a GPIO/pwrseq problem despite the symptom.
			 */
			uwe5622_bsp: uwe-bsp {
				compatible = "unisoc,uwe_bsp";
				/*
				 * Without this, sdiohal_parse_dt()
				 * (unisocwcn/sdio/sdiohal_main.c) can't
				 * resolve the mmc_host behind this chip
				 * (sdiohal_dev_get_host() gets a NULL node
				 * and fails), so sdiohal_parse_dt() returns
				 * -1 and sdiohal_init() bails out *before*
				 * ever calling sdiohal_misc_init() --
				 * silently skipping sdiohal_sleep_flag_init(),
				 * which is the only place flag_resume ever
				 * gets set to 1. Confirmed on real hardware
				 * by direct instrumentation: with this
				 * property missing, flag_resume stays 0 for
				 * the entire boot, so every single SDIO
				 * register access pays sdiohal_resume_check()'s
				 * full ~30s spin-wait (5000 retries of
				 * usleep_range(4000,6000), never satisfied,
				 * then proceeding anyway) before the driver's
				 * own POWERUP_WAIT_MS watchdog gives up first
				 * and kills the connection outright -- not a
				 * firmware, power-rail, or ADMA problem, just
				 * this one missing phandle. Needs this board's
				 * dtb built with dtc's -@ symbol-table flag
				 * (patches/0003) to resolve &mmc1 by label.
				 */
				sdhci-name = <&mmc1>;
				/*
				 * In-band SDIO IRQ (the mmc1 node already
				 * has cap-sdio-irq) instead of a dedicated
				 * external GPIO line -- matches the
				 * CONFIG_SDIO_INBAND_INT build flag's intent,
				 * but sdiohal_parse_dt() (unisocwcn/sdio/
				 * sdiohal_main.c) only honors that flag when
				 * CONFIG_WCN_PARSE_DTS is *off*; when it's on
				 * (our case), a "data-irq"/"rx-polling"
				 * property on *this* node unconditionally
				 * overrides it, defaulting to an external-IRQ
				 * mode that then reads a nonexistent
				 * "sdio-ext-int-gpio" property and fails with
				 * request_irq(0, ...) -- not present here on
				 * purpose, so this property is required, not
				 * redundant with the build flag.
				 */
				data-irq;
				/* SOC pad PG19, module pad NC */
				bt-reg-on = <&pio 6 19 GPIO_ACTIVE_LOW>;
				bt-wake-host;
				/* SOC pad PG16, module pad INT */
				bt-wake-host-gpio = <&pio 6 16 GPIO_ACTIVE_HIGH>;
				status = "okay";
			};
		};
	};
};
